## boards/shields/lily58/Kconfig.defconfig
```kconfig
if SHIELD_LILY58_DONGLE

config ZMK_KEYBOARD_NAME
    default "Lily58"

config ZMK_SPLIT_ROLE_CENTRAL
    default y

config ZMK_SPLIT
    default y

# Set this to the number of peripherals your dongle will have.
# For a unibody, this would be 1. If you have left and right halves, set it to 2, etc.
config ZMK_SPLIT_BLE_CENTRAL_PERIPHERALS
    default 1

endif
```
